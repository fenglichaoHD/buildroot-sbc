## buildroot/package/freescale-imx/imx-mcuxpresso/Config.in
```kconfig
config BR2_PACKAGE_IMX_MCUXPRESSO
	bool "imx-mcuxpresso"
	depends on BR2_arm || BR2_aarch64 # Only relevant for i.MX
	depends on BR2_TOOLCHAIN_USES_GLIBC # prebuilt binaries
	help
	  Binary mcuxpresso libraries for the NXP i.MX SoCs.

	  This library is provided by NXP as-is and doesn't have
	  an upstream.

comment "imx-mcuxpresso needs a glibc toolchain"
	depends on BR2_arm || BR2_aarch64
	depends on !BR2_TOOLCHAIN_USES_GLIBC
```
